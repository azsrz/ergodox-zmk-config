## config/west.yml
```yaml
manifest:
  remotes:
    - name: slicemk
      url-base: https://github.com/slicemk
  projects:
    - name: zmk
      remote: slicemk
      revision: v20230210-locality-mouse
      import: app/west.yml
  self:
    path: config
```
